## src/drivers/instrument/Kconfig
```kconfig
menu "Instrument"
    menuconfig COMMON_INSTRUMENT
        bool "Common Instrument's"
        default n
        select DRIVERS_INSTRUMENT_ATMEGA2560
        ---help---
            Enable default set of reference instrument drivers
    rsource "*/Kconfig"
endmenu
```

## src/drivers/instrument/atmega2560/Kconfig
```kconfig
menuconfig DRIVERS_INSTRUMENT_ATMEGA2560
	bool "atmega2560"
	default n
	---help---
		Enable support for atmega2560
```

## src/drivers/position_sensor/Kconfig
```kconfig
menu "Position sensors"
    menuconfig COMMON_POSITION_SENSOR
        bool "Common position sensor's"
        default n
        select DRIVERS_POSITION_SENSOR_AS5600L0
        select DRIVERS_POSITION_SENSOR_AS5600L1
        ---help---
            Enable default set of position sensor drivers
    rsource "*/Kconfig"
endmenu
```

## src/drivers/position_sensor/as5600l0/Kconfig
```kconfig
menuconfig DRIVERS_POSITION_SENSOR_AS5600L0
	bool "as5600l0"
	default n
	---help---
		Enable support for as5600l0
```

## src/drivers/position_sensor/as5600l1/Kconfig
```kconfig
menuconfig DRIVERS_POSITION_SENSOR_AS5600L1
	bool "as5600l1"
	default n
	---help---
		Enable support for as5600l1
```

## src/drivers/rpm/Kconfig
```kconfig
menu "RPM"
    menuconfig COMMON_RPM
        bool "Common RPM's"
        default n
        select DRIVERS_RPM_ATMEGA4809
        ---help---
            Enable default set of rpm drivers
    rsource "*/Kconfig"
endmenu
```

## src/drivers/rpm/atmega4809/Kconfig
```kconfig
menuconfig DRIVERS_RPM_ATMEGA4809
	bool "atmega4809"
	default n
	---help---
		Enable support for atmega4809
```

## src/modules/airdata_boom/Kconfig
```kconfig
menuconfig MODULES_AIRDATA_BOOM
	bool "airdata_boom"
	default n
	---help---
		Enable support for airdata_boom

menuconfig USER_AIRDATA_BOOM
	bool "airdata_boom running as userspace module"
	default y
	depends on BOARD_PROTECTED && MODULES_AIRDATA_BOOM
	---help---
		Put airdata_boom in userspace memory
```

## src/modules/system_identification_data/Kconfig
```kconfig
menuconfig MODULES_SYSTEM_IDENTIFICATION_DATA
	bool "system_identification_data"
	default n
	---help---
		Enable support for system_identification_data

menuconfig USER_SYSTEM_IDENTIFICATION_DATA
	bool "system_identification_data running as userspace module"
	default y
	depends on BOARD_PROTECTED && MODULES_SYSTEM_IDENTIFICATION_DATA
	---help---
		Put system_identification_data in userspace memory
```
